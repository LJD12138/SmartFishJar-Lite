/*****************************************************************************************************************
*                                                                                                                *
 *                                         鐑鐞嗕换鍔★紙椋庢墖+鍔犵儹妫掞級                                           *
*                                                                                                                *
******************************************************************************************************************/
#include "MD_HeatManage/md_hm_task.h"
#include "MD_HeatManage/md_hm_iface.h"
#include "freertos.h"
#include "task.h"
#include "Sys/sys_task.h"
#include "board_config.h"
#include "Print/print_task.h"
#if(boardADC_EN)
#include "Adc/adc_task.h"
#endif

//****************************************************浠诲姟鍒濆鍖?*************************************************//
#if(boardUSE_OS)
#define        	HM_TASK_PRIO                  			1
#define        	HM_TASK_STK_SIZE              			192
TaskHandle_t    tHeatManageHandler = NULL;
void           	vHW_Task(void *pvParameters);
#endif  //boardUSE_OS

//****************************************************鍙傛暟鍒濆鍖?*************************************************//
HM_T           tHM;

static bool b_fan_stop_to_run_flag = 0;
static u8   uc_updata_delay = 0;
static s16  s_water_temp = 0;     // 姘存俯锛堝彇NTC1/NTC2鍧囧€硷級
static u16  us_heat_pwm  = 0;    // 鍔犵儹妫扨WM褰撳墠鍊?
//****************************************************鍑芥暟澹版槑****************************************************//
static void v_fan_pwm_set(u8 fan_id, u16 level);
static void v_heat_pwm_set(u16 level);
static u16  us_fan_set_work_mode(FanWorkMode_E mode);


/*****************************************************************************************************************
-----鍑芥暟鍔熻兘    鐑鐞嗕换鍔″垵濮嬪寲
******************************************************************************************************************/
bool bHM_TaskInit(void)
{
    vFan_PwmInit();

    #if(boardUSE_OS)
    xTaskCreate((TaskFunction_t )vHW_Task,
                (const char* )"bHeatManage",
                (uint16_t ) HM_TASK_STK_SIZE,
                (void* )NULL,
                (UBaseType_t ) HM_TASK_PRIO,
                (TaskHandle_t*)&tHeatManageHandler);
    #endif  //boardUSE_OS

    return true;
}

/*****************************************************************************************************************
-----鍑芥暟鍔熻兘    鐑鐞嗗惊鐜换鍔?******************************************************************************************************************/
void vHW_Task(void *pvParameters)
{
    #if(boardUSE_OS)
    for(;;)
    #endif
    {
        if(bSys_IsWorkState() == true || tSysInfo.eDevState == DS_ERR)
        {
            /* 姣?S鏇存柊涓€娆℃按娓╋紙鍙朜TC1/NTC2鍧囧€硷級 */
            if(++uc_updata_delay >= 3)
            {
                uc_updata_delay = 0;
                #if(boardADC_EN && boardWATER_TEMP_EN)
                s_water_temp = (tAdcSamp.sWaterTemp1 + tAdcSamp.sWaterTemp2) / 2;
                #else
                s_water_temp = tSysInfo.sMaxTemp;
                #endif
            }

            /* 椋庢墖鎺у埗锛氫互PCB娓╁害锛?V/12V NTC涓緝楂樺€硷級涓哄熀鍑?*/
            s16 pcb_temp = 0;
            #if(boardADC_EN)
            pcb_temp = (tAdcSamp.s5VTemp > tAdcSamp.s12VTemp) ? tAdcSamp.s5VTemp : tAdcSamp.s12VTemp;
            #endif

            switch (tHM.eWordMode)
            {
                default:
                case FWM_OFF:
                    if(pcb_temp > 40)
                        tHM.usValue = us_fan_set_work_mode(FWM_GEAR_1);
                    break;
                case FWM_GEAR_1:
                    if(pcb_temp < 38)
                        tHM.usValue = us_fan_set_work_mode(FWM_OFF);
                    else if(pcb_temp > 44)
                        tHM.usValue = us_fan_set_work_mode(FWM_GEAR_2);
                    break;
                case FWM_GEAR_2:
                    if(pcb_temp < 42)
                        tHM.usValue = us_fan_set_work_mode(FWM_GEAR_1);
                    else if(pcb_temp > 48)
                        tHM.usValue = us_fan_set_work_mode(FWM_GEAR_3);
                    break;
                case FWM_GEAR_3:
                    if(pcb_temp < 46)
                        tHM.usValue = us_fan_set_work_mode(FWM_GEAR_2);
                    else if(pcb_temp > 52)
                        tHM.usValue = us_fan_set_work_mode(FWM_GEAR_FULL);
                    break;
                case FWM_GEAR_FULL:
                    if(pcb_temp < 50)
                        tHM.usValue = us_fan_set_work_mode(FWM_GEAR_3);
                    break;
            }

            /* 浠庡仠姝綆妗ｅ惎鍔紝缁欎竴涓珮涓€妗ｇ殑鍚姩鍐查噺 */
            if((tHM.eWordMode < FWM_GEAR_2 && tHM.eWordMode > FWM_OFF) && b_fan_stop_to_run_flag == 0)
            {
                b_fan_stop_to_run_flag = 1;
                tHM.usValue = us_fan_set_work_mode(FWM_GEAR_2);
            }

            v_fan_pwm_set(0, tHM.usValue);
            #if(boardFAN2_EN)
            v_fan_pwm_set(1, tHM.usValue);  // 鍙岄鎵囧悓姝?            #endif

            /* 鍔犵儹妫掓帶鍒讹細姘存俯浣庝簬璁惧畾鍊兼椂鍔犵儹 */
            #if(boardWATER_TEMP_EN)
            {
                u16 target_heat = 0;
                if(s_water_temp < 22)
                    target_heat = hmPWM_MAX_VALUE;       // 鍏ㄥ姛鐜囧姞鐑?                else if(s_water_temp < 25)
                    target_heat = hmPWM_MAX_VALUE / 2;   // 鍗婂姛鐜?                else
                    target_heat = 0;                      // 鍋滄鍔犵儹

                if(us_heat_pwm != target_heat)
                {
                    us_heat_pwm = target_heat;
                    v_heat_pwm_set(us_heat_pwm);
                }
            }
            #endif
        }
        else  /* 闈炲伐浣滅姸鎬侊紝鍏抽棴鏁ｇ儹鍜屽姞鐑?*/
        {
            if(tHM.eWordMode != FWM_OFF || tHM.usValue != 0)
            {
                tHM.usValue = us_fan_set_work_mode(FWM_OFF);
                v_fan_pwm_set(0, tHM.usValue);
                #if(boardFAN2_EN)
                v_fan_pwm_set(1, tHM.usValue);
                #endif
            }
            if(us_heat_pwm != 0)
            {
                us_heat_pwm = 0;
                v_heat_pwm_set(0);
            }
        }

        v_heat_pwm_set(1000);  // 娴嬭瘯鐢細鍔犵儹妫掑叏鍔熺巼0

        #if(boardUSE_OS)
        vTaskDelay(1000);
        #endif
    }
}

/*****************************************************************************************************************
-----鍑芥暟鍔熻兘    璁剧疆椋庢墖PWM锛堟敮鎸佸弻椋庢墖鐙珛鎺у埗锛?-----浼犲叆鍙傛暟    fan_id: 0=椋庢墖1  1=椋庢墖2
                level:  PWM鍊硷紙0~hmPWM_MAX_VALUE锛?******************************************************************************************************************/
static void v_fan_pwm_set(u8 fan_id, u16 level)
{
    level = LIMIT_MAX(level, hmPWM_MAX_VALUE);
    if(fan_id == 0)
        fanPWM1_SET(level);
    #if(boardFAN2_EN)
    else
        fanPWM2_SET(level);
    #endif
}

/*****************************************************************************************************************
-----鍑芥暟鍔熻兘    璁剧疆鍔犵儹妫扨WM
-----浼犲叆鍙傛暟    level: PWM鍊硷紙0~hmPWM_MAX_VALUE锛?******************************************************************************************************************/
static void v_heat_pwm_set(u16 level)
{
    level = LIMIT_MAX(level, hmPWM_MAX_VALUE);
    heatPWM_SET(level);
}

/*****************************************************************************************************************
-----鍑芥暟鍔熻兘    璁剧疆椋庢墖宸ヤ綔妯″紡锛岃繑鍥炲搴擯WM鍊?******************************************************************************************************************/
static u16 us_fan_set_work_mode(FanWorkMode_E mode)
{
    u16 temp = 0;

    switch(mode)
    {
        case FWM_GEAR_1:   temp = 200;            break;
        case FWM_GEAR_2:   temp = 500;            break;
        case FWM_GEAR_3:   temp = 800;            break;
        case FWM_GEAR_FULL: temp = hmPWM_MAX_VALUE; break;
        default:
            temp = 0;
            b_fan_stop_to_run_flag = 0;
            mode = FWM_OFF;
            break;
    }

    tHM.eWordMode = mode;
    return temp;
}


/************************************************************************************************************************
                                                  鍏ㄥ眬鍑芥暟
*************************************************************************************************************************/

FanWorkMode_E eFan_GetWorkMode(void)
{
    return tHM.eWordMode;
}

void vFan_ForceOpenFan(bool en)
{
    if(en)
        tHM.usValue = us_fan_set_work_mode(FWM_GEAR_FULL);
    else
        tHM.usValue = us_fan_set_work_mode(FWM_OFF);
    v_fan_pwm_set(0, tHM.usValue);
    #if(boardFAN2_EN)
    v_fan_pwm_set(1, tHM.usValue);
    #endif
}

#if(boardLOW_POWER)
void vFan_EnterLowPower(void)
{
    vFan_IoEnterLowPower();
}

void vFan_ExitLowPower(void)
{
    vFan_PwmInit();
}
#endif

